## arch/arm64/src/a527/Kconfig
```kconfig
#
# For a description of the syntax of this configuration file,
# see the file kconfig-language.txt in the NuttX tools repository.
#

if ARCH_CHIP_A527

menu "A527 Virt Chip Selection"

choice
	prompt "A527 Core Configuration"
	default ARCH_CHIP_A527_A53

config ARCH_CHIP_A527_A53
	bool "A527 virtual Processor (cortex-a53)"
	select ARCH_HAVE_MULTICPU
	select ARMV8A_HAVE_GICv3
	select ARM64_HAVE_PSCI
	select ARCH_CORTEX_A53

endchoice # A527 Chip Selection

config ARCH_CHIP_A527_WITH_HV
	bool "A527 with hypvervisor (e.g. kvm, hvf)"
	default n

endmenu # "A527 Chip Selection"

endif # ARCH_CHIP_A527
```

## arch/arm64/src/a64/Kconfig
```kconfig
#
# For a description of the syntax of this configuration file,
# see the file kconfig-language.txt in the NuttX tools repository.
#

if ARCH_CHIP_A64

menu "Allwinner A64 Peripheral Selection"

config A64_DE
	bool "DE"
	default n
	select A64_TCON0
	---help---
		Select to enable support for Display Engine 2.0.

config A64_MIPI_DSI
	bool "MIPI DSI"
	default n
	---help---
		Select to enable support for MIPI Display Serial Interface (DSI)
		and MIPI Display Physical Layer (D-PHY).

config A64_RSB
	bool "RSB"
	default n
	---help---
		Select to enable support for Reduced Serial Bus.

config A64_TCON0
	bool "TCON0"
	default n
	select A64_MIPI_DSI
	---help---
		Select to enable support for Timing Controller TCON0.

config A64_RTWI
	bool "Two-wire Master Controller R"
	default n
	---help---
		Select to enable support for R_TWI.

config A64_TWI0
	bool "Two-wire Master Controller 0"
	default n
	---help---
		Select to enable support for TWI0.

config A64_TWI1
	bool "Two-wire Master Controller 1"
	default n
	---help---
		Select to enable support for TWI1.

config A64_TWI2
	bool "Two-wire Master Controller 2"
	default n
	---help---
		Select to enable support for TWI2.

#####################################################################
#  UART Configuration
#####################################################################

config A64_UART
	bool "UART 0"
	default n
	select UART0_SERIALDRIVER
	select ARCH_HAVE_SERIAL_TERMIOS
	---help---
		Select to enable support for UART0.

if A64_UART

	config A64_UART0_RXBUFSIZE
		int "Receive buffer size"
		default 64
		---help---
			Characters are buffered as they are received. This specifies
			the size of the receive buffer.

	config A64_UART0_TXBUFSIZE
		int "Transmit buffer size"
		default 64
		---help---
			Characters are buffered before being sent.  This specifies
			the size of the transmit buffer.

	config A64_UART0_BAUD
		int "BAUD rate"
		default 115200
		---help---
			The configured BAUD of the UART.

	config A64_UART0_BITS
		int "Character size"
		default 8
		range 8 9
		---help---
			The number of bits.  Must be either 8 or 9.

	config A64_UART0_PARITY
		int "Parity setting"
		range 0 2
		default 0
		---help---
			0=No parity, 1=Odd parity, 2=Even parity

	config A64_UART0_2STOP
		int "Use 2 stop bits"
		default 0
		range 0 1
		---help---
			1=Two stop bits

endif # A64_UART0

#####################################################################

config A64_UART1
	bool "UART 1"
	default n
	select UART1_SERIALDRIVER
	select ARCH_HAVE_SERIAL_TERMIOS
	---help---
		Select to enable support for UART1.

#####################################################################

config A64_UART2
	bool "UART 2"
	default n
	select UART2_SERIALDRIVER
	select ARCH_HAVE_SERIAL_TERMIOS
	---help---
		Select to enable support for UART2.

#####################################################################

config A64_UART3
	bool "UART 3"
	default n
	select UART3_SERIALDRIVER
	select ARCH_HAVE_SERIAL_TERMIOS
	---help---
		Select to enable support for UART3.

#####################################################################

config A64_UART4
	bool "UART 4"
	default n
	select UART4_SERIALDRIVER
	select ARCH_HAVE_SERIAL_TERMIOS
	---help---
		Select to enable support for UART4.

endmenu # Allwinner A64 Peripheral Selection

endif # ARCH_CHIP_A64
```

## arch/risc-v/src/bl808/Kconfig
```kconfig
#
# For a description of the syntax of this configuration file,
# see the file kconfig-language.txt in the NuttX tools repository.
#

comment "BL808 Configuration Options"

menu "BL808 Peripheral Support"

config BL808_HAVE_UART3
	bool "UART3"
	select BL808_UART3
	select ARCH_HAVE_UART3
	select UART3_SERIALDRIVER
	select ARCH_HAVE_SERIAL_TERMIOS
	select ARCH_HAVE_PWM_MULTICHAN

config BL808_UART3
	bool
	default n

endmenu
```

## arch/risc-v/src/sg2000/Kconfig
```kconfig
#
# For a description of the syntax of this configuration file,
# see the file kconfig-language.txt in the NuttX tools repository.
#

comment "SG2000 Configuration Options"

menu "SG2000 Peripheral Support"

config SG2000_UART3
	bool "UART 3"
	default n
	select UART3_SERIALDRIVER
	select ARCH_HAVE_SERIAL_TERMIOS

endmenu
```
